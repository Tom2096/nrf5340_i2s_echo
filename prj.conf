## CMakeLists.txt
```
#
# Copyright (c) 2022 Nordic Semiconductor ASA
#
# SPDX-License-Identifier: LicenseRef-Nordic-5-Clause
#

cmake_minimum_required(VERSION 3.20.0)

# Flag which defines whether application is compiled as gateway/dongle or headset
add_compile_definitions(HEADSET=1)
add_compile_definitions(GATEWAY=2)

find_package(Zephyr REQUIRED HINTS $ENV{ZEPHYR_BASE})

project(nrf5340_i2s_echo)

string(TIMESTAMP NRF5340_AUDIO_CORE_APP_COMP_DATE "%a %b %d %H:%M:%S %Y")

# Generate fw_info_app.c
configure_file("${CMAKE_CURRENT_SOURCE_DIR}/src/utils/fw_info_app.c.in"
               "${CMAKE_BINARY_DIR}/fw_info_app.c"
               @ONLY)

# Target sources below are specific to the nRF5340 Audio DK HW
target_sources(app PRIVATE
    ${CMAKE_BINARY_DIR}/fw_info_app.c
    src/main.c
    )

# Include application events and configuration headers
zephyr_library_include_directories(
    include
    src/audio
    src/bluetooth
    src/drivers
    src/modules
    src/utils
    src/utils/macros
)

zephyr_library_include_directories(app PRIVATE
    ${ZEPHYR_NRF_MODULE_DIR}/boards/arm/nrf5340_audio_dk_nrf5340)

# Application sources
add_subdirectory(src/audio)
add_subdirectory(src/bluetooth)
add_subdirectory(src/drivers)
add_subdirectory(src/modules)
add_subdirectory(src/utils)

## Cirrus Logic
if (CONFIG_HW_CODEC_CIRRUS_LOGIC)
    if (ZEPHYR_CIRRUS_LOGIC_MODULE_DIR)
        add_subdirectory(${ZEPHYR_CIRRUS_LOGIC_MODULE_DIR} cirrus_logic_bin_dir)
    else()
        message(FATAL_ERROR "Cirrus Logic/sdk-mcu-drivers repository not found\n")
    endif()
endif()
```

## prj.conf
```kconfig
#
# Copyright (c) 2022 Nordic Semiconductor ASA
#
# SPDX-License-Identifier: LicenseRef-Nordic-5-Clause
#

# nRF5340 Audio
CONFIG_NRF5340_AUDIO=y
CONFIG_SAMPLE_RATE_CONVERTER=y
CONFIG_SAMPLE_RATE_CONVERTER_FILTER_SIMPLE=y

# Custom audio configs
CONFIG_NRF5340_AUDIO_CS47L63_DRIVER=y
CONFIG_WALKIE_TALKIE_DEMO=y
CONFIG_AUDIO_SAMPLE_RATE_16000_HZ=y
CONFIG_AUDIO_SOURCE_USB=n

# General
CONFIG_DEBUG=y
CONFIG_DEBUG_INFO=y
CONFIG_ASSERT=y
CONFIG_STACK_USAGE=y
CONFIG_THREAD_RUNTIME_STATS=y
CONFIG_STACK_SENTINEL=y
CONFIG_INIT_STACKS=y

# Uart driver
CONFIG_SERIAL=y

# Logging
CONFIG_LOG=y
CONFIG_NEWLIB_LIBC_FLOAT_PRINTF=y
CONFIG_LOG_TAG_MAX_LEN=2
CONFIG_LOG_TAG_DEFAULT="--"
CONFIG_LOG_BACKEND_UART=y
CONFIG_LOG_BUFFER_SIZE=4096

# Use this for debugging thread usage
#CONFIG_LOG_THREAD_ID_PREFIX=y

# Console related defines
CONFIG_CONSOLE=y
CONFIG_RTT_CONSOLE=y
CONFIG_UART_CONSOLE=y

# Shell related defines
CONFIG_SHELL=y
CONFIG_KERNEL_SHELL=y
CONFIG_USE_SEGGER_RTT=y
## Disable logs on RTT
CONFIG_SHELL_RTT_INIT_LOG_LEVEL_NONE=y
CONFIG_SHELL_BACKEND_RTT=y
CONFIG_SHELL_BACKEND_SERIAL=n
CONFIG_SHELL_VT100_COMMANDS=y
CONFIG_SHELL_VT100_COLORS=y
CONFIG_SHELL_STACK_SIZE=4096
CONFIG_SHELL_CMD_BUFF_SIZE=128
## Reduce shell memory usage
CONFIG_SHELL_WILDCARD=n
CONFIG_SHELL_HELP_ON_WRONG_ARGUMENT_COUNT=n
CONFIG_SHELL_STATS=n
CONFIG_SHELL_CMDS=n
CONFIG_SHELL_HISTORY=y

# Turn off default shell commands
CONFIG_I2C_SHELL=n
CONFIG_HWINFO_SHELL=n
CONFIG_CLOCK_CONTROL_NRF_SHELL=n
CONFIG_FLASH_SHELL=n
CONFIG_DEVICE_SHELL=n

# Suppress LOG_ERR messages from sd_check_card_type. Because SPI_SDHC has no card presence method,
# assume card is in slot. Thus error message is always shown if card is not inserted
CONFIG_SD_LOG_LEVEL_OFF=y

# Suppress LOG_INF messages from hci_core
CONFIG_BT_HCI_CORE_LOG_LEVEL_WRN=y
```

## src/main.c
```c
/*
	Author: Siyuan He
	Email: sy4he@uwaterloo.ca

    This is a simple example of how to use the I2S callback to achieve a simple audio out from PDM -> Headphones.
*/

#include <zephyr/kernel.h>
#include <nrfx_clock.h>
#include <audio_i2s.h>
#include <audio_i2s_macros.h>
#include <zephyr/sys/ring_buffer.h>
#include <pcm_stream_channel_modifier.h>
#include <macros_common.h>
#include <hw_codec.h>
#include <tone.h>

#include <zephyr/logging/log.h>
LOG_MODULE_REGISTER(main, CONFIG_MAIN_LOG_LEVEL);

#define CONFIG_LOGGING

static uint8_t *tx_buf;
static uint8_t *rx_buf;

/* Ring buffer for PDM Mic input */
RING_BUF_DECLARE(ringbuf_audio_in, RING_BUF_SIZE);

/* Ring buffer for intermediate processing */
RING_BUF_DECLARE(ringbuf_audio_tmp, RING_BUF_SIZE);

/* Ring buffer for headphone out */
RING_BUF_DECLARE(ringbuf_audio_out, RING_BUF_SIZE);

/* Alternate-buffers used when there is no active audio stream.
 * Used interchangeably by I2S.
 */
static struct {
	uint8_t __aligned(WB_UP(1)) buf_0[BLK_STEREO_SIZE_OCTETS];
	uint8_t __aligned(WB_UP(1)) buf_1[BLK_STEREO_SIZE_OCTETS];
	bool buf_0_in_use;
	bool buf_1_in_use;
} alt;

/**
 * @brief	Get first available alternative-buffer.
 *
 * @param	p_buffer	Double pointer to populate with buffer.
 *
 * @retval	0 if success.
 * @retval	-ENOMEM No available buffers.
 */
static int alt_buffer_get(void **p_buffer)
{
	if (!alt.buf_0_in_use) {
		alt.buf_0_in_use = true;
		*p_buffer = alt.buf_0;
	} else if (!alt.buf_1_in_use) {
		alt.buf_1_in_use = true;
		*p_buffer = alt.buf_1;
	} else {
		return -ENOMEM;
	}

	return 0;
}

/**
 * @brief	Frees both alternative buffers.
 */
static void alt_buffer_free_both(void)
{
	alt.buf_0_in_use = false;
	alt.buf_1_in_use = false;
}

/**
 * @brief	Function to be called when I2S transfer is complete (every ~1ms).
 * 			
 * @param	frame_start_ts_us 	I2S frame start timestamp
 * @param	rx_buf_released 	Pointer to the released buffer containing PDM received data
 * @param	tx_buf_released 	Pointer to the released buffer that was used to send data
 */
static void i2s_callback(uint32_t frame_start_ts_us, uint32_t *rx_buf_released,
					    uint32_t const *tx_buf_released)
{

	/* There should be 2 main parts to this callback:
	 *
	 * 1st. RX: The rx_buf_released is the buffer that was just filled with PDM data, 
	 *		we should now call ring_buf_put_finish to complete the data write operation.
	 *
	 * 2nd. TX: The tx_buf_released is the buffer that was just sent to the I2S peripheral,
	 *		we should now call ring_buf_get_claim to claim the next buffer to be sent.
	 */

	int ret;
	size_t transfer_size = I2S_TRANSFER_SIZE;

	/********** I2S RX **********/
	if (rx_buf_released != NULL) {
		ret = ring_buf_put_finish(&ringbuf_audio_in, transfer_size);
		if (ret) {
			LOG_WRN("Ring buf put finish err: %d", ret);
		}

		/* Attempt to make space in the ring buffer for rx_buf */
		if (ring_buf_space_get(&ringbuf_audio_in) < transfer_size) {
			LOG_ERR("Overflow in ring buffer");
			return;
		}
		transfer_size = ring_buf_put_claim(&ringbuf_audio_in, &rx_buf, transfer_size);
		if (transfer_size != I2S_TRANSFER_SIZE) {
			LOG_ERR("Write size (%d) not equal requested size (%d)", transfer_size, I2S_TRANSFER_SIZE);
			return;
		}
	} else {
		LOG_ERR("rx_buf_released is null!");
		return;
	}

	/********** I2S TX **********/
	if (tx_buf_released != NULL) {

		/* Finish reading the previous tx_buf */
		ret = ring_buf_get_finish(&ringbuf_audio_out, transfer_size);
		if (ret) {
			LOG_WRN("Ring buf get finish err: %d", ret);
		}

		transfer_size = ring_buf_get_claim(&ringbuf_audio_out, &tx_buf, transfer_size);
		if (transfer_size != I2S_TRANSFER_SIZE) {
			LOG_WRN("Read size (%d) not equal requested size (%d)", transfer_size, I2S_TRANSFER_SIZE);
		}
	} else {
		LOG_ERR("tx_buf_released is null!");
		return;
	}

	/*** Data exchange ***/
	audio_i2s_set_next_buf(tx_buf, (uint32_t *)rx_buf);
}

static int hfclock_config_and_start(void)
{
	int ret;

	/* Use this to turn on 128 MHz clock for cpu_app */
	ret = nrfx_clock_divider_set(NRF_CLOCK_DOMAIN_HFCLK, NRF_CLOCK_HFCLK_DIV_1);

	ret -= NRFX_ERROR_BASE_NUM;
	if (ret) {
		return ret;
	}

	nrfx_clock_hfclk_start();
	while (!nrfx_clock_hfclk_is_running()) {
	}

	return 0;
}

int main(void) 
{
    int ret;

#ifdef CONFIG_LOGGING
    printk("\nLogging I2S Info ...\n");
    printk("\nCONFIG_I2S_LRCK_FREQ_HZ:     %d\n", CONFIG_I2S_LRCK_FREQ_HZ);
    printk("\nCONFIG_I2S_CH_NUM:           %d\n", CONFIG_I2S_CH_NUM);
    printk("\nCONFIG_AUDIO_BIT_DEPTH_BITS: %d\n", CONFIG_AUDIO_BIT_DEPTH_BITS);
	printk("\nI2S_SAMPLES_NUM: 		   	   %d\n", I2S_SAMPLES_NUM);
	printk("\nBLK_STEREO_SIZE_OCTETS: 	   %d\n", BLK_STEREO_SIZE_OCTETS);
#endif
 
	ret = hfclock_config_and_start();
	ERR_CHK(ret);

	audio_i2s_blk_comp_cb_register(i2s_callback);
	audio_i2s_init();

	ret = hw_codec_init();
	if (ret) {
		LOG_ERR("Failed to initialize HW codec: %d", ret);
		return ret;
	}
	hw_codec_volume_set(200);

	printk("\nStarting I2S!\n");

	/* Starting I2S */

	/********** I2S TX **********/
	ret = alt_buffer_get((void **)&tx_buf);
	ERR_CHK(ret);

	/********** I2S RX **********/
	ret = alt_buffer_get((void **)&rx_buf);
	ERR_CHK(ret);

	memset(tx_buf, 0, BLK_STEREO_SIZE_OCTETS);

	ret = hw_codec_default_conf_enable();
	ERR_CHK(ret);
	audio_i2s_start(tx_buf, (uint32_t *)rx_buf);
	// Need to run this manually once to trigger the callback
	audio_i2s_set_next_buf(tx_buf, (uint32_t *)rx_buf);
	
    /**
     * 
     *  We will run the I2S for 5 seconds and then stop it.
     * 
     *  The I2S callback will be called every ~1ms, and we will, in a busy loop, repeatly read from ringbuf_audio_in and write to ringbuf_audio_tmp.
     *  This is to simulate some processing that would be done on the audio data. We will then read from ringbuf_audio_tmp and write to ringbuf_audio_out.
     * 
     */
    
	uint8_t *data_buf;
	size_t transfer_size;
	int64_t start_time = k_uptime_get();

	while (true) {
		int64_t current_time = k_uptime_get();
		int64_t elapsed_time_ms = current_time - start_time;
		
        if (elapsed_time_ms >= 5000) { // Check if 5000 ms has passed
            break; // Exit the loop after 5 seconds
        }

		transfer_size = I2S_TRANSFER_SIZE;
		/* Attempt to read from ringbuf_audio_in */
		if (ring_buf_size_get(&ringbuf_audio_in) > 0) {
			/* Attempt to make space in ringbuf_audio_tmp */
			if (ring_buf_space_get(&ringbuf_audio_tmp) < transfer_size) {
				LOG_ERR("Overflow in ringbuf_audio_tmp");
				break;
			}
			transfer_size = ring_buf_get_claim(&ringbuf_audio_in, &data_buf, transfer_size);
			if (transfer_size != I2S_TRANSFER_SIZE) {
				LOG_ERR("Read size of ringbuf_audio_in (%d) not equal available_data (%d)", transfer_size, I2S_TRANSFER_SIZE);
				break;
			}
			transfer_size = ring_buf_put(&ringbuf_audio_tmp, data_buf, transfer_size);
			if (transfer_size != I2S_TRANSFER_SIZE) {
				LOG_ERR("Write size of ringbuf_audio_tmp (%d) not equal available_data (%d)", transfer_size, I2S_TRANSFER_SIZE);
				break;
			}
			ret = ring_buf_get_finish(&ringbuf_audio_in, transfer_size);
			if (ret) {
				LOG_ERR("ringbuf_audio_in get finish err: %d", ret);
				break;
			}
		}

		transfer_size = RING_BUF_BATCH_SIZE;
		/* Attempt to write from ringbuf_audio_tmp to ringbuf_audio_out */
		if (ring_buf_size_get(&ringbuf_audio_tmp) >= transfer_size) {
			/* Attempt to make space in ringbuf_audio_out */
			if (ring_buf_space_get(&ringbuf_audio_out) < transfer_size) {
				LOG_ERR("Overflow in ringbuf_audio_out");
				break;
			}
			transfer_size = ring_buf_get_claim(&ringbuf_audio_tmp, &data_buf, transfer_size);
			if (transfer_size != RING_BUF_BATCH_SIZE) {
				LOG_ERR("Read size of ringbuf_audio_tmp (%d) not equal available_data (%d)", transfer_size, RING_BUF_BATCH_SIZE);
				break;
			}
			transfer_size = ring_buf_put(&ringbuf_audio_out, data_buf, transfer_size);
			if (transfer_size != RING_BUF_BATCH_SIZE) {
				LOG_ERR("Write size of ringbuf_audio_out (%d) not equal available_data (%d)", transfer_size, RING_BUF_BATCH_SIZE);
				break;
			}
			ret = ring_buf_get_finish(&ringbuf_audio_tmp, transfer_size);
			if (ret) {
				LOG_ERR("ringbuf_audio_tmp get finish err: %d", ret);
				break;
			}
		}
	}

	ret = hw_codec_soft_reset();
	ERR_CHK(ret);
	audio_i2s_stop();
	
	alt_buffer_free_both();

	printk("\nI2S Stopped!\n");

    return 0;
}
```

## include/audio_i2s_macros.h
```c
#include <audio_i2s.h>

#define BLK_PERIOD_US 1000

/* Number of audio blocks given a duration */
#define NUM_BLKS(d) ((d) / BLK_PERIOD_US)
/* Single audio block size in number of samples (stereo) */
/* clang-format off */
#define BLK_SIZE_SAMPLES(r) (((r)*BLK_PERIOD_US) / 1000000)

#define NUM_BLKS_IN_FRAME      NUM_BLKS(CONFIG_AUDIO_FRAME_DURATION_US)
#define BLK_MONO_NUM_SAMPS     BLK_SIZE_SAMPLES(CONFIG_AUDIO_SAMPLE_RATE_HZ)

/* Number of octets in a single audio block */
#define BLK_MONO_SIZE_OCTETS   (BLK_MONO_NUM_SAMPS * CONFIG_AUDIO_BIT_DEPTH_OCTETS)
#define BLK_STEREO_SIZE_OCTETS (BLK_MONO_SIZE_OCTETS * 2)

/* Size of ring buffer in bytes */
#define RING_BUF_SIZE 1920

/* How many bytes we read/write to ring buffers during every I2S transfer */
#define I2S_TRANSFER_SIZE 64

/* How many samples we need for a single batch into the processing */
#define RING_BUF_BATCH_SIZE 128
```
